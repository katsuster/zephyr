## boards/riscv/nsitexe_ns31a_arty_a7/Kconfig.board
```kconfig
# SPDX-License-Identifier: Apache-2.0

config BOARD_NSITEXE_NS31A_ARTY_A7
	bool "NSITEXE Akaria NS31A on Arty A7 target"
	depends on SOC_NSITEXE_AKARIA_NS31A_EVAL
```

## boards/riscv/nsitexe_ns31a_arty_a7/nsitexe_ns31a_arty_a7_defconfig
```kconfig
# SPDX-License-Identifier: Apache-2.0

CONFIG_SOC_SERIES_NSITEXE_AKARIA_NS31A=y
CONFIG_SOC_NSITEXE_AKARIA_NS31A_EVAL=y
CONFIG_BOARD_NSITEXE_NS31A_ARTY_A7=y
CONFIG_CONSOLE=y
CONFIG_SERIAL=y
CONFIG_UART_CONSOLE=y
CONFIG_STACK_SENTINEL=y
CONFIG_XIP=n
CONFIG_RISCV_PMP=y
```

## boards/riscv/qemu_riscv64/qemu_riscv64_defconfig
```kconfig
# SPDX-License-Identifier: Apache-2.0

CONFIG_SOC_SERIES_RISCV_VIRT=y
CONFIG_SOC_RISCV_VIRT=y
CONFIG_BOARD_QEMU_RISCV64=y
CONFIG_CONSOLE=y
CONFIG_SERIAL=y
CONFIG_UART_NS16550=y
CONFIG_UART_CONSOLE=y
CONFIG_PLIC=y
CONFIG_RISCV_MACHINE_TIMER=y
CONFIG_STACK_SENTINEL=y
CONFIG_XIP=n

CONFIG_QEMU_ICOUNT=n
CONFIG_SMP=y
CONFIG_MP_NUM_CPUS=2


CONFIG_LOG_PROCESS_THREAD_STACK_SIZE=3072

CONFIG_MAIN_STACK_SIZE=8192
CONFIG_IDLE_STACK_SIZE=4096
CONFIG_ISR_STACK_SIZE=16384
CONFIG_TEST_EXTRA_STACKSIZE=4096
CONFIG_SYSTEM_WORKQUEUE_STACK_SIZE=8192
```

## soc/riscv/nsitexe_akaria/Kconfig
```kconfig
# SPDX-License-Identifier: Apache-2.0

config SOC_FAMILY_NSITEXE_AKARIA
	bool

if SOC_FAMILY_NSITEXE_AKARIA

config SOC_FAMILY
	string
	default "nsitexe_akaria"

source "soc/riscv/nsitexe_akaria/*/Kconfig.soc"

endif # SOC_FAMILY_NSITEXE_AKARIA
```

## soc/riscv/nsitexe_akaria/Kconfig.defconfig
```kconfig
# SPDX-License-Identifier: Apache-2.0

source "soc/riscv/nsitexe_akaria/*/Kconfig.defconfig"
```

## soc/riscv/nsitexe_akaria/Kconfig.soc
```kconfig
# SPDX-License-Identifier: Apache-2.0

source "soc/riscv/nsitexe_akaria/*/Kconfig.series"
```

## soc/riscv/nsitexe_akaria/ns31a/Kconfig.series
```kconfig
# SPDX-License-Identifier: Apache-2.0

config SOC_SERIES_NSITEXE_AKARIA_NS31A
	bool "NSITEXE Akaria NS31A SoC series"
	select RISCV
	select RISCV_PRIVILEGED
	select SOC_FAMILY_NSITEXE_AKARIA
	help
	  Enable support for NSITEXE Akaria NS31A SoC implementations
```

## soc/riscv/nsitexe_akaria/ns31a/Kconfig.soc
```kconfig
# SPDX-License-Identifier: Apache-2.0

choice
	prompt "NSITEXE Akaria NS31A SoC"
	depends on SOC_SERIES_NSITEXE_AKARIA_NS31A

config SOC_NSITEXE_AKARIA_NS31A_EVAL
	bool "NSITEXE Akaria NS31A SoC Implementation for FPGA"
	select ATOMIC_OPERATIONS_BUILTIN
	select INCLUDE_RESET_VECTOR
	select RISCV_ISA_RV32I
	select RISCV_ISA_EXT_M
	select RISCV_ISA_EXT_A
	select RISCV_ISA_EXT_C
	select RISCV_ISA_EXT_ZICSR
	select RISCV_ISA_EXT_ZIFENCEI

endchoice
```
