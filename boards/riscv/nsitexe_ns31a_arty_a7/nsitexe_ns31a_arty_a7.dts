/* SPDX-License-Identifier: Apache-2.0 */

/dts-v1/;

#include <nsitexe/nsitexe-ns31a-eval.dtsi>

/ {
	chosen {
		zephyr,console = &uart0;
		zephyr,shell-uart = &uart0;
		zephyr,sram = &itim0;
	};
};

&uart0 {
	status = "okay";
};
